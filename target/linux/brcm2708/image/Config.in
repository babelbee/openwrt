## target/linux/brcm2708/image/Config.in
```kconfig
config BRCM2708_SD_BOOT_PARTSIZE
	int "Boot (SD Card) filesystem partition size (in MB)"
	depends on TARGET_brcm2708
	default 20

config BRCM2708_EXTRA_CMDLINE
	string "Extra command line arguments for the kernel"
	depends on TARGET_brcm2708
```
